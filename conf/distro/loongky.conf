## conf/distro/loongky.conf
```bitbake
DISTRO = "loongky"
DISTRO_NAME = "Loongky (Yocto Project Reference Distro)"
DISTRO_VERSION = "0.1.1"
DISTRO_CODENAME = "walnascar"
SDK_VENDOR = "-loongky"
SDK_VERSION = "${@d.getVar('DISTRO_VERSION').replace('snapshot-${METADATA_REVISION}', 'snapshot')}"
SDK_VERSION[vardepvalue] = "${SDK_VERSION}"

MAINTAINER = "Poky Maintainers <poky@lists.yoctoproject.org>"

TARGET_VENDOR = "-loongky"

LOCALCONF_VERSION = "2"

DISTRO_FEATURES ?= "${DISTRO_FEATURES_DEFAULT}"

PREFERRED_VERSION_linux-yocto ?= "6.12%"
PREFERRED_VERSION_linux-yocto-rt ?= "6.12%"

SDK_NAME = "${DISTRO}-${TCLIBC}-${SDKMACHINE}-${IMAGE_BASENAME}-${TUNE_PKGARCH}-${MACHINE}"
SDKPATHINSTALL = "/opt/${DISTRO}/${SDK_VERSION}"

DISTRO_EXTRA_RDEPENDS += " packagegroup-core-boot"
DISTRO_EXTRA_RRECOMMENDS += " "

PACKAGE_CLASSES ?= "package_rpm"

SANITY_TESTED_DISTROS ?= " \
            poky-5.1 \n \
            poky-5.2 \n \
            ubuntu-20.04 \n \
            ubuntu-22.04 \n \
            ubuntu-24.04 \n \
            ubuntu-24.10 \n \
            fedora-39 \n \
            fedora-40 \n \
            fedora-41 \n \
            centosstream-9 \n \
            debian-11 \n \
            debian-12 \n \
            opensuseleap-15.5 \n \
            opensuseleap-15.6 \n \
            almalinux-8.8 \n \
            almalinux-9.2 \n \
            rocky-8 \n \
            rocky-9 \n \
            "
# add poky sanity bbclass
INHERIT += "poky-sanity"

# QA check settings - a little stricter than the OE-Core defaults
# (none currently necessary as we now match OE-Core)
#WARN_TO_ERROR_QA = "X"
#WARN_QA:remove = "${WARN_TO_ERROR_QA}"
#ERROR_QA:append = " ${WARN_TO_ERROR_QA}"

require conf/distro/include/no-static-libs.inc
require conf/distro/include/security_flags.inc
require conf/distro/include/yocto-space-optimize.inc

BB_SIGNATURE_HANDLER ?= "OEEquivHash"
BB_HASHSERVE ??= "auto"

INIT_MANAGER ?= "sysvinit"

# We need debug symbols so that SPDX license manifests for the kernel work
KERNEL_EXTRA_FEATURES:append = " features/debug/debug-kernel.scc"

# Enable creation of SPDX manifests by default
# INHERIT += "create-spdx"
```

## conf/machine/include/loongson-2k0300.inc
```bitbake
require conf/machine/include/loongarch/tune-loongarch.inc

PREFERRED_PROVIDER_virtual/kernel = "linux-loongson2"

PREFERRED_PROVIDER_virtual/bootloader = "u-boot"
PREFERRED_VERSION_u-boot = "2024.04"

EXTRA_IMAGEDEPENDS += " u-boot "

INIT_MANAGER = "systemd"

# 注释掉会编译不带initramfs的fitimage
# INITRAMFS_IMAGE = "core-image-minimal-initramfs"
# INIT_MANAGER = "mdev-busybox"

KERNEL_CLASSES += "kernel-fit-extra-artifacts"
MACHINE_ESSENTIAL_EXTRA_RDEPENDS += "linux-yocto-fitimage"

KERNEL_IMAGETYPE = "vmlinux"
KERNEL_DEVICETREE = " \
    loongson_2k0300_99_pai_wifi.dtb \
    loongson_2k0300_99_pai_tfcard.dtb \
    "

FIT_CONF_DEFAULT_DTB ?= "loongson_2k0300_99_pai_wifi.dtb"
FIT_ADDRESS_CELLS = "2"
FIT_HASH_ALG = "sha1"

UBOOT_MACHINE ?= "loongson_2k0300_defconfig"

# by u-boot configure
UBOOT_DTB_LOADADDRESS = "0x900000000a000000"
UBOOT_LOADADDRESS = "0x9000000000200000"
UBOOT_ENTRYSYMBOL = "kernel_entry"

UBOOT_RD_LOADADDRESS = "0x9000000006000000"
UBOOT_RD_ENTRYPOINT = "0x9000000006000000"

IMAGE_FSTYPES = "tar.gz"

SERIAL_CONSOLES ?= "115200;ttyS0"

ERROR_QA:remove = "patch-status"

DISTRO_FEATURES:remove = " 3g alsa bluetooth pulseaudio vulkan wayland x11 ptest"

EXTRA_IMAGE_FEATURES += "allow-empty-password empty-root-password allow-root-login"
```

## conf/machine/loongson-2k0300-99pai.conf
```bitbake
require conf/machine/include/loongson-2k0300.inc

KBUILD_DEFCONFIG = "ls2k0300_99_pai_wifi_defconfig"

LICENSE_FLAGS_ACCEPTED:append = " commercial"
```
